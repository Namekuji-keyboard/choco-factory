## firmware/choco-key/studio/Kconfig
```kconfig
# Choco Factory runtime configuration (ZMK v0.2.1)

DT_COMPAT_CHOCO_BEHAVIOR_VKEY := zmk,behavior-choco-vkey
DT_COMPAT_CHOCO_RUNTIME_COMBO := zmk,behavior-choco-runtime-combos

config CHOCO_BEHAVIOR_VKEY
    bool "Virtual key behavior (press the binding at a virtual key position)"
    default $(dt_compat_enabled,$(DT_COMPAT_CHOCO_BEHAVIOR_VKEY))

config CHOCO_RUNTIME_COMBO
    bool "Combos configured from keymap bindings (editable with ZMK Studio)"
    default $(dt_compat_enabled,$(DT_COMPAT_CHOCO_RUNTIME_COMBO))

config CHOCO_RUNTIME_COMBO_MAX_PENDING
    int "Max keys captured while a combo is being detected"
    default 4
    depends on CHOCO_RUNTIME_COMBO

config CHOCO_RUNTIME_COMBO_MAX_ACTIVE
    int "Max combos held at the same time"
    default 4
    depends on CHOCO_RUNTIME_COMBO
```

## firmware/choco-key/studio/dts/bindings/behaviors/zmk,behavior-choco-runtime-combos.yaml
```yaml
description: |
  Combo configuration slot. The two parameters encode the combo (key positions, timeout,
  active layers). The combo engine reads these bindings from layer 0 at runtime, so combos can
  be created / edited / deleted with ZMK Studio without rebuilding the firmware.

  param1: bit n = key position n (0-30)
  param2: bits 0-10 = key positions 31-41, bits 11-20 = timeout (ms, 0 = slot unused),
          bits 21-25 = layer groups (OS, 0 = all), bits 26-30 = layer in group (0 = all)

compatible: "zmk,behavior-choco-runtime-combos"

include: two_param.yaml

properties:
  config-first-position:
    type: int
    required: true
  output-first-position:
    type: int
    required: true
  slots:
    type: int
    required: true
  physical-keys:
    type: int
    required: true
  layers-per-group:
    type: int
    default: 5
```

## firmware/choco-key/studio/dts/bindings/behaviors/zmk,behavior-choco-vkey.yaml
```yaml
description: |
  Virtual key. Pressing it presses the keymap binding at the given (virtual) key position
  of the currently active layers. Used for rotary encoders and macros whose actions are
  edited at runtime with ZMK Studio.

compatible: "zmk,behavior-choco-vkey"

include: one_param.yaml
```
